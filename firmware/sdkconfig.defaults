## firmware/sdkconfig.defaults
```kconfig
#
# Flash & Partition Configuration
#
CONFIG_ESPTOOLPY_FLASHSIZE_4MB=y
CONFIG_PARTITION_TABLE_CUSTOM=y
CONFIG_PARTITION_TABLE_CUSTOM_FILENAME="partitions.csv"

#
# Compiler Optimization
#
CONFIG_COMPILER_OPTIMIZATION_SIZE=y

#
# Github OTA Configuration
#
CONFIG_MAX_FILENAME_LEN=64
CONFIG_MAX_URL_LEN=1024
CONFIG_GITHUB_HOSTNAME="api.github.com"
CONFIG_GITHUB_OWNER="ProjectBarks"
CONFIG_GITHUB_REPO="subway-pcb"
# end of Github OTA Configuration

#
# Wifi Manager Configuration
#
CONFIG_WIFI_MANAGER_TASK_PRIORITY=5
CONFIG_WIFI_MANAGER_RETRY_TIMER=5000
CONFIG_WIFI_MANAGER_MAX_RETRY_START_AP=3
CONFIG_WIFI_MANAGER_SHUTDOWN_AP_TIMER=60000
CONFIG_WEBAPP_LOCATION="/"
CONFIG_DEFAULT_AP_SSID="nyc-subway-pcb"
CONFIG_DEFAULT_AP_PASSWORD="password"
CONFIG_DEFAULT_AP_CHANNEL=1
CONFIG_DEFAULT_AP_IP="10.10.0.1"
CONFIG_DEFAULT_AP_GATEWAY="10.10.0.1"
CONFIG_DEFAULT_AP_NETMASK="255.255.255.0"
CONFIG_DEFAULT_AP_MAX_CONNECTIONS=4
CONFIG_DEFAULT_AP_BEACON_INTERVAL=100
# end of Wifi Manager Configuration

#
# Brownout Detector - disable to prevent false resets during WiFi RF cal
#
CONFIG_ESP_BROWNOUT_DET=n

#
# PHY calibration — cache in NVS so subsequent boots skip full RF cal
#
CONFIG_ESP_PHY_CALIBRATION_AND_DATA_STORAGE=y

#
# Reduce current draw during WiFi PHY init
#
CONFIG_ESP_PHY_MAX_WIFI_TX_POWER=10

#
# TLS memory optimization — reduce heap pressure for concurrent Lua + HTTPS
#
CONFIG_MBEDTLS_SSL_IN_CONTENT_LEN=8192
CONFIG_MBEDTLS_SSL_OUT_CONTENT_LEN=4096

#
# Task watchdog — auto-reset on hung tasks (30s timeout)
#
CONFIG_ESP_TASK_WDT_EN=y
CONFIG_ESP_TASK_WDT_TIMEOUT_S=30
CONFIG_ESP_TASK_WDT_PANIC=y
```

## sdkconfig.defaults
```kconfig
#
# Github OTA Configuration
#
CONFIG_MAX_FILENAME_LEN=64
CONFIG_MAX_URL_LEN=128
CONFIG_GITHUB_HOSTNAME="api.github.com"
CONFIG_GITHUB_OWNER="ProjectBarks"
CONFIG_GITHUB_REPO="subway-pcb"
# end of Github OTA Configuration

#
# Wifi Manager Configuration
#
CONFIG_WIFI_MANAGER_TASK_PRIORITY=5
CONFIG_WIFI_MANAGER_RETRY_TIMER=5000
CONFIG_WIFI_MANAGER_MAX_RETRY_START_AP=3
CONFIG_WIFI_MANAGER_SHUTDOWN_AP_TIMER=60000
CONFIG_WEBAPP_LOCATION="/"
CONFIG_DEFAULT_AP_SSID="nyc-subway-pcb"
CONFIG_DEFAULT_AP_PASSWORD="password"
CONFIG_DEFAULT_AP_CHANNEL=1
CONFIG_DEFAULT_AP_IP="10.10.0.1"
CONFIG_DEFAULT_AP_GATEWAY="10.10.0.1"
CONFIG_DEFAULT_AP_NETMASK="255.255.255.0"
CONFIG_DEFAULT_AP_MAX_CONNECTIONS=4
CONFIG_DEFAULT_AP_BEACON_INTERVAL=100
# end of Wifi Manager Configuration
```
